## subsys/nfc/Kconfig.nfc
```kconfig
#
# Copyright (c) 2019 Nordic Semiconductor ASA
#
# SPDX-License-Identifier: LicenseRef-BSD-5-Clause-Nordic
#

config NFCT_IRQ_PRIORITY
	int
	prompt "Interrupt priority"
	range 0 6
	default 1
	help
	  Sets NFC interrupt priority.
	  Levels are from 0 (highest priority) to 6 (lowest priority)

module = NFC_PLATFORM
module-str = nfc_platform
source "${ZEPHYR_BASE}/subsys/logging/Kconfig.template.log_config"
```
